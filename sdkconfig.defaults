## sdkconfig.defaults
```kconfig
# Enable custom partition table for OTA support
CONFIG_PARTITION_TABLE_CUSTOM=y
CONFIG_PARTITION_TABLE_CUSTOM_FILENAME="partitions.csv"

# Enable OTA support
CONFIG_BOOTLOADER_APP_ROLLBACK_ENABLE=y

# Flash size - ESP32-WROOM-32UE comes in 4MB, 8MB, or 16MB variants
# Partition table uses ~3.1MB, so minimum is 4MB
CONFIG_ESPTOOLPY_FLASHSIZE_4MB=y
CONFIG_ESPTOOLPY_FLASHSIZE="4MB"
```
